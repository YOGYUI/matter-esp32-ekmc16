## sdkconfig.defaults
```kconfig
# Default to 921600 baud when flashing and monitoring device
CONFIG_ESPTOOLPY_BAUD_921600B=y
CONFIG_ESPTOOLPY_BAUD=921600
CONFIG_ESPTOOLPY_COMPRESSED=y
CONFIG_ESPTOOLPY_MONITOR_BAUD_115200B=y
CONFIG_ESPTOOLPY_MONITOR_BAUD=115200
CONFIG_ESPTOOLPY_FLASHSIZE_4MB=y

#enable BT
CONFIG_BT_ENABLED=y
CONFIG_BT_NIMBLE_ENABLED=y

#enable lwip ipv6 autoconfig
CONFIG_LWIP_IPV6_AUTOCONFIG=y

# Use a custom partition table
CONFIG_PARTITION_TABLE_CUSTOM=y
CONFIG_PARTITION_TABLE_FILENAME="partitions.csv"
CONFIG_PARTITION_TABLE_OFFSET=0xC000

# Enable chip shell
CONFIG_ENABLE_CHIP_SHELL=n

#enable lwIP route hooks
CONFIG_LWIP_HOOK_IP6_ROUTE_DEFAULT=y
CONFIG_LWIP_HOOK_ND6_GET_GW_DEFAULT=y

# Button
CONFIG_BUTTON_PERIOD_TIME_MS=20
CONFIG_BUTTON_LONG_PRESS_TIME_MS=5000

# Disable DS Peripheral
CONFIG_ESP_SECURE_CERT_DS_PERIPHERAL=n

CONFIG_LWIP_LOCAL_HOSTNAME="yogyui-matter-si7021"
CONFIG_LWIP_MAX_SOCKETS=16
CONFIG_LWIP_IRAM_OPTIMIZATION=y
CONFIG_LWIP_NETIF_LOOPBACK=y
# CONFIG_LWIP_LOOPBACK_MAX_PBUFS=1

#
# CHIP Device Layer::General Options
#
CONFIG_CHIP_TASK_STACK_SIZE=8192
CONFIG_CHIP_TASK_PRIORITY=1
CONFIG_MAX_EVENT_QUEUE_SIZE=25
# end of General Options

#
# Commissioning options
#
CONFIG_ENABLE_ESP32_FACTORY_DATA_PROVIDER=y
CONFIG_ENABLE_ESP32_DEVICE_INSTANCE_INFO_PROVIDER=y
CONFIG_ENABLE_ESP32_DEVICE_INFO_PROVIDER=y
# end of Commissioning options

#
# ESP Matter
#
CONFIG_ESP_MATTER_NVS_PART_NAME="nvs"
CONFIG_FACTORY_PARTITION_DAC_PROVIDER=y
CONFIG_FACTORY_COMMISSIONABLE_DATA_PROVIDER=y
CONFIG_FACTORY_DEVICE_INSTANCE_INFO_PROVIDER=y
CONFIG_FACTORY_DEVICE_INFO_PROVIDER=y
# end of ESP Matter

#
# OTA
#
CONFIG_ENABLE_OTA_REQUESTOR=y
CONFIG_OTA_AUTO_REBOOT_ON_APPLY=y
CONFIG_OTA_AUTO_REBOOT_DELAY_MS=5000
CONFIG_CHIP_OTA_IMAGE_BUILD=y

#
# Optimize IRAM usage
#
CONFIG_FREERTOS_PLACE_FUNCTIONS_INTO_FLASH=y
CONFIG_FREERTOS_PLACE_SNAPSHOT_FUNS_INTO_FLASH=y
CONFIG_RINGBUF_PLACE_FUNCTIONS_INTO_FLASH=y
CONFIG_RINGBUF_PLACE_ISR_FUNCTIONS_INTO_FLASH=y

#
# ESP Matter Controller
#
CONFIG_ESP_MATTER_CONTROLLER_ENABLE=n
CONFIG_ESP_MATTER_COMMISSIONER_ENABLE=n

#
# ADC-Calibration
#
CONFIG_ADC_CAL_EFUSE_TP_ENABLE=n
CONFIG_ADC_CAL_EFUSE_VREF_ENABLE=n
CONFIG_ADC_CAL_LUT_ENABLE=n

#
# Newlib
#
# CONFIG_NEWLIB_NANO_FORMAT=y

#
#
#
CONFIG_ESP_TASK_WDT_CHECK_IDLE_TASK_CPU0=n
CONFIG_ESP_TASK_WDT_CHECK_IDLE_TASK_CPU1=n

#
# ESP32-specific
#
#CONFIG_ESP32_REV_MIN_3=y
#CONFIG_ESP32_REV_MIN=3

# Compiler options
CONFIG_COMPILER_OPTIMIZATION_SIZE=y
CONFIG_COMPILER_OPTIMIZATION_ASSERTIONS_DISABLE=y
CONFIG_COMPILER_OPTIMIZATION_CHECKS_SILENT=y
CONFIG_ESP_ERR_TO_NAME_LOOKUP=n

#
# 2023.05.31 - esp-matter problem
#
CONFIG_MBEDTLS_HKDF_C=y

# High performance WiFi
CONFIG_ESP32_WIFI_STATIC_RX_BUFFER_NUM=6
CONFIG_ESP32_WIFI_DYNAMIC_RX_BUFFER_NUM=24
CONFIG_ESP32_WIFI_DYNAMIC_TX_BUFFER_NUM=24
CONFIG_ESP32_WIFI_RX_BA_WIN=12
CONFIG_LWIP_TCP_SND_BUF_DEFAULT=24576
CONFIG_LWIP_TCP_WND_DEFAULT=24576
```
